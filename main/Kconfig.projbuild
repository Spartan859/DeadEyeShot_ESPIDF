## main/Kconfig.projbuild
```kconfig
menu "DeadEyeShot"

    config DEADEYE_CAMERA_FPS_TEST
        bool "Run camera FPS test only"
        default n
        help
            Initialize only NVS and camera, then continuously capture frames and
            print FPS statistics. This isolates camera driver throughput from
            WiFi, BLE, web server, and app logic.

endmenu
```

## sdkconfig.defaults
```kconfig
# DeadEyeShot - ESP32-S3 Smart Shooting Crosshair Module
# Target
CONFIG_IDF_TARGET="esp32s3"

# Flash size (actual hardware is 16MB)
CONFIG_ESPTOOLPY_FLASHSIZE_16MB=y
CONFIG_ESPTOOLPY_FLASHSIZE="16MB"

# CPU Frequency
CONFIG_ESP32S3_DEFAULT_CPU_FREQ_240=y

# PSRAM - try octal first, will auto-detect
CONFIG_SPIRAM=y
CONFIG_SPIRAM_MODE_OCT=y
CONFIG_SPIRAM_SPEED_80M=y
CONFIG_SPIRAM_USE_MALLOC=y
CONFIG_SPIRAM_MALLOC_ALWAYSINTERNAL=16384
CONFIG_SPIRAM_MALLOC_RESERVE_INTERNAL=32768

# BLE
CONFIG_BT_ENABLED=y
CONFIG_BTDM_CTRL_MODE_BLE_ONLY=y
CONFIG_BT_BLE_42_FEATURES_SUPPORTED=y
CONFIG_BT_GATTS_NOTIFY_THROUGHPUT=y

# Suppress warnings-as-errors for managed components with deprecated headers
CONFIG_COMPILER_WARNINGS_AS_ERRORS=n

# Partition table
CONFIG_PARTITION_TABLE_CUSTOM=y
CONFIG_PARTITION_TABLE_CUSTOM_FILENAME="partitions.csv"

# Enable camera driver I2C
CONFIG_CAMERA_CORE0=y

CONFIG_FREERTOS_HZ=1000

# WebSocket video stream
CONFIG_HTTPD_WS_SUPPORT=y
```
